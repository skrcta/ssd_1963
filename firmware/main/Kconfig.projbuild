## firmware/main/Kconfig.projbuild
```kconfig
menu "ER-TFT050 display test"

config HMI_LCD_PCLK_HZ
    int "8080 write clock (Hz)"
    range 1000000 20000000
    default 10000000
    help
        Start at 10 MHz for bring-up. Raise only after the wiring is stable.

config HMI_LCD_BACKLIGHT_ACTIVE_HIGH
    bool "Backlight enable is active high"
    default y
    help
        Default for the external BL_ON/OFF jumper configuration in the wiring guide.

menu "Display GPIO map"

config HMI_LCD_PIN_D0
    int "DB0 GPIO"
    range 0 48
    default 2
    help
        ESP32-S3 GPIO number. Firmware rejects unavailable, input-only, or
        duplicate assignments at startup.
config HMI_LCD_PIN_D1
    int "DB1 GPIO"
    range 0 48
    default 4
    help
        ESP32-S3 GPIO number. Firmware rejects unavailable, input-only, or
        duplicate assignments at startup.
config HMI_LCD_PIN_D2
    int "DB2 GPIO"
    range 0 48
    default 5
    help
        ESP32-S3 GPIO number. Firmware rejects unavailable, input-only, or
        duplicate assignments at startup.
config HMI_LCD_PIN_D3
    int "DB3 GPIO"
    range 0 48
    default 6
    help
        ESP32-S3 GPIO number. Firmware rejects unavailable, input-only, or
        duplicate assignments at startup.
config HMI_LCD_PIN_D4
    int "DB4 GPIO"
    range 0 48
    default 7
    help
        ESP32-S3 GPIO number. Firmware rejects unavailable, input-only, or
        duplicate assignments at startup.
config HMI_LCD_PIN_D5
    int "DB5 GPIO"
    range 0 48
    default 8
    help
        ESP32-S3 GPIO number. Firmware rejects unavailable, input-only, or
        duplicate assignments at startup.
config HMI_LCD_PIN_D6
    int "DB6 GPIO"
    range 0 48
    default 9
    help
        ESP32-S3 GPIO number. Firmware rejects unavailable, input-only, or
        duplicate assignments at startup.
config HMI_LCD_PIN_D7
    int "DB7 GPIO"
    range 0 48
    default 10
    help
        ESP32-S3 GPIO number. Firmware rejects unavailable, input-only, or
        duplicate assignments at startup.
config HMI_LCD_PIN_CS
    int "CS GPIO"
    range 0 48
    default 11
    help
        ESP32-S3 GPIO number. Firmware rejects unavailable, input-only, or
        duplicate assignments at startup.
config HMI_LCD_PIN_DC
    int "D/C GPIO"
    range 0 48
    default 12
    help
        ESP32-S3 GPIO number. Firmware rejects unavailable, input-only, or
        duplicate assignments at startup.
config HMI_LCD_PIN_WR
    int "WR GPIO"
    range 0 48
    default 13
    help
        ESP32-S3 GPIO number. Firmware rejects unavailable, input-only, or
        duplicate assignments at startup.
config HMI_LCD_PIN_RD
    int "RD GPIO (held high by this write-only test)"
    range 0 48
    default 14
    help
        ESP32-S3 GPIO number. Firmware drives RD high and rejects unavailable,
        input-only, or duplicate assignments at startup.
config HMI_LCD_PIN_RESET
    int "RESET GPIO"
    range 0 48
    default 15
    help
        ESP32-S3 GPIO number. Firmware rejects unavailable, input-only, or
        duplicate assignments at startup.
config HMI_LCD_PIN_BACKLIGHT
    int "BL_ON/OFF GPIO"
    range 0 48
    default 16
    help
        ESP32-S3 GPIO number. Firmware rejects unavailable, input-only, or
        duplicate assignments at startup.

endmenu
endmenu

menu "RS-485"

config HMI_RS485_UART_NUM
    int "UART peripheral number (1 or 2)"
    range 1 2
    default 1
    help
        UART0 pins (GPIO 43/44) are not exposed on the Pico headers.

config HMI_RS485_TXD_GPIO
    int "TXD GPIO (to transceiver DI)"
    range 0 48
    default 36
    help
        Must be output-capable. Firmware rejects unavailable, input-only,
        or duplicate assignments at startup.

config HMI_RS485_RXD_GPIO
    int "RXD GPIO (from transceiver RO)"
    range 0 48
    default 37
    help
        Firmware rejects unavailable or duplicate assignments at startup.

config HMI_RS485_DIR_GPIO
    int "DIR GPIO (to transceiver DE & RE!)"
    range 0 48
    default 35
    help
        Must be output-capable. Driven by UART RTS, not by application
        code. Firmware rejects unavailable, input-only, or duplicate
        assignments at startup.

config HMI_RS485_BAUD_RATE
    int "Baud rate"
    range 1200 460800
    default 9600
    help
        Standard Modbus RTU baud rates: 9600, 19200, 38400, 115200.

endmenu
```

## firmware/sdkconfig.defaults
```kconfig
CONFIG_IDF_TARGET="esp32s3"
CONFIG_FREERTOS_HZ=1000
CONFIG_COMPILER_OPTIMIZATION_PERF=y
CONFIG_ESPTOOLPY_FLASHSIZE_16MB=y
CONFIG_ESPTOOLPY_FLASHSIZE="16MB"
```
